## conf/layer.conf
```bitbake
# We have a conf and classes directory, add to BBPATH
BBPATH .= ":${LAYERDIR}"

# We have recipes-* directories, add to BBFILES
BBFILES += "${LAYERDIR}/meta-common/recipes-*/*/*.bb \
            ${LAYERDIR}/meta-common/recipes-*/*/*.bbappend"

BBFILE_COLLECTIONS += "inspur"
BBFILE_PATTERN_inspur = ""
LAYERVERSION_inspur = "1"

INSPURBASE = '${@os.path.normpath("${LAYERDIR}/")}'
```
